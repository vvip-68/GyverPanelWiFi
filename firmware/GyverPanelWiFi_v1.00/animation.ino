byte FRAME_WIDTH = 16;
byte FRAME_HEIGHT = 16;

#include "bitmap1.h"

// ------------------- Загрузка картинок и фреймов анимации -------------------
// Данный пример работает при размере матрицы 16x16 - такие картинки подготовлены в этом файле
// для других размеров матрицы - подготовьте собственные картинки

void loadImage(const uint16_t (*frame)) {
  int8_t offset_x = (WIDTH - FRAME_WIDTH) / 2;
  int8_t offset_y = (HEIGHT - FRAME_HEIGHT) / 2;
  byte effectBrightness = getBrightnessCalculated(globalBrightness, effectContrast[thisMode]);
  for (byte i = 0; i < FRAME_WIDTH; i++) {
    if (offset_x + i < 0 || offset_x + i > WIDTH - 1) continue;
    for (byte j = 0; j < FRAME_HEIGHT; j++) {
      if (offset_y + j < 0  || offset_y + j > HEIGHT - 1) continue;
      CRGB color = gammaCorrection(expandColor((pgm_read_word(&(frame[(FRAME_HEIGHT - j - 1) * FRAME_WIDTH + i])))));
      color.nscale8_video(effectBrightness);
      drawPixelXY(offset_x + i, offset_y + j, color);
    }
  }
}

byte currentImageIdx = 1;
byte frameNum = 0;

void animationRoutine() {
  // "n" - индекс в наборе фреймов анимации (подготовленных картинок)
  if (loadingFlag) {
    loadingFlag = false;
    // modeCode = MC_IMAGE;
    switch (currentImageIdx) {
      case 1:
        FRAME_WIDTH = 16;
        FRAME_HEIGHT = 16;
        break;
    }
    frameNum = 0;
    FastLED.clear();
  }
  
  switch (currentImageIdx) {
    case 1:
      loadImage(mario_array[frameNum]);
      if (++frameNum >= sizeof(mario_array) / sizeof(mario_array[0])) frameNum = 0;
      break;
  }
}

// ---------------------------------------------------------------------------------
// ---------------------------------------------------------------------------------
// ---------------------------------------------------------------------------------


// Gamma коррекция (Defalt Gamma = 2.8)
const uint8_t PROGMEM gammaR[] = {
  0,  0,  0,  0,  0,  0,  0,  0,  0,  0,  0,  0,  0,  0,  0,  0,
  0,  0,  0,  0,  0,  0,  0,  0,  0,  0,  0,  0,  0,  1,  1,  1,
  1,  1,  1,  1,  1,  1,  1,  1,  1,  1,  1,  2,  2,  2,  2,  2,
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  194, 196, 199, 201, 203, 206, 208, 210, 213, 215, 218, 220, 223, 225, 227, 230
};

const uint8_t PROGMEM gammaG[] = {
  0,  0,  0,  0,  0,  0,  0,  0,  0,  0,  0,  0,  0,  0,  0,  0,
  0,  0,  0,  0,  0,  0,  0,  0,  0,  0,  0,  0,  1,  1,  1,  1,
  1,  1,  1,  1,  1,  1,  1,  1,  1,  2,  2,  2,  2,  2,  2,  2,
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  215, 218, 220, 223, 225, 228, 231, 233, 236, 239, 241, 244, 247, 249, 252, 255
};

const uint8_t PROGMEM gammaB[] = {
  0,  0,  0,  0,  0,  0,  0,  0,  0,  0,  0,  0,  0,  0,  0,  0,
  0,  0,  0,  0,  0,  0,  0,  0,  0,  0,  0,  0,  0,  0,  0,  1,
  1,  1,  1,  1,  1,  1,  1,  1,  1,  1,  1,  1,  1,  2,  2,  2,
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  169, 171, 173, 175, 177, 179, 181, 183, 185, 187, 189, 191, 193, 196, 198, 200
};

// гамма-коррекция (более натуральные цвета)
uint32_t gammaCorrection(uint32_t color) {
  byte r = (color >> 16) & 0xFF;  // Extract the RR byte
  byte g = (color >> 8) & 0xFF;   // Extract the GG byte
  byte b = color & 0xFF;        // Extract the BB byte

  r = pgm_read_byte(&gammaR[r]);
  g = pgm_read_byte(&gammaG[g]);
  b = pgm_read_byte(&gammaB[b]);

  uint32_t newColor = ((long)(r & 0xff) << 16) + ((long)(g & 0xff) << 8) + ((long)b & 0xff);
  return newColor;
}

// gamma correction для expandColor
static const uint8_t PROGMEM
gamma5[] = {
  0x00, 0x01, 0x02, 0x03, 0x05, 0x07, 0x09, 0x0b,
  0x0e, 0x11, 0x14, 0x18, 0x1d, 0x22, 0x28, 0x2e,
  0x36, 0x3d, 0x46, 0x4f, 0x59, 0x64, 0x6f, 0x7c,
  0x89, 0x97, 0xa6, 0xb6, 0xc7, 0xd9, 0xeb, 0xff
},
gamma6[] = {
  0x00, 0x01, 0x02, 0x03, 0x04, 0x05, 0x06, 0x08,
  0x09, 0x0a, 0x0b, 0x0d, 0x0e, 0x10, 0x12, 0x13,
  0x15, 0x17, 0x19, 0x1b, 0x1d, 0x20, 0x22, 0x25,
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  0xc7, 0xcf, 0xd6, 0xde, 0xe6, 0xee, 0xf7, 0xff
};

// преобразовать цвет из 16 битного в 24 битный
static uint32_t expandColor(uint16_t color) {
  return ((uint32_t)pgm_read_byte(&gamma5[ color >> 11       ]) << 16) |
         ((uint32_t)pgm_read_byte(&gamma6[(color >> 5) & 0x3F]) <<  8) |
         pgm_read_byte(&gamma5[ color       & 0x1F]);
}
